## CMakeLists.txt
```
cmake_minimum_required(VERSION 3.20.0)

list(APPEND BOARD_ROOT ${CMAKE_CURRENT_SOURCE_DIR}/..)
list(APPEND ZEPHYR_EXTRA_MODULES ${CMAKE_CURRENT_SOURCE_DIR}/../modules/l6task1-driver-module)
find_package(Zephyr REQUIRED)
project(my_zephyr_app)

target_sources(app PRIVATE src/main.cpp)
```

## Kconfig
```
config APP_HEARTBEAT_PERIOD
    int "App Heartbeat Period (ms)"
    default 500
    range 100 2000
    help
      Set the period for the application heartbeat in milliseconds.

menuconfig LED_SUBSYSTEM
    bool "LED Subsystem"
    default y
    help
      Enable the LED subsystem.

if LED_SUBSYSTEM

choice
    prompt "LED blink sleep time"
    default LED_BLINK_SLEEP_TIME_1000MS
    help
      Select the LED driver to use.

config LED_BLINK_SLEEP_TIME_250MS
    bool "250ms (fast)"

config LED_BLINK_SLEEP_TIME_1000MS
    bool "1s (medium)"

config LED_BLINK_SLEEP_TIME_2000MS
    bool "2s (slow)"

endchoice

config LED_BLINK_SLEEP_TIME
    int
    default 250 if LED_BLINK_SLEEP_TIME_250MS
    default 1000 if LED_BLINK_SLEEP_TIME_1000MS
    default 2000 if LED_BLINK_SLEEP_TIME_2000MS

menuconfig LED_ADVANCED_SETTINGS
    bool "Advance LED settings"
    default n
    help
      Enable advanced LED settings.

if LED_ADVANCED_SETTINGS

  config LED_BRIGHTNESS
    int "LED brightness (0-100)"
    default 100
    range 0 100
    help
      Set the LED brightness level.

  config LED_FADE_DURATION
    int "LED fade duration (ms)"
    default 500
    help
      Set the LED fade duration.

  menu "Expert settings"

    config LED_DEBUGGING
        bool "Enable LED debugging"
        default n
        help
          Enable debugging for the LED subsystem.

    config CUSTOM_BLINK_PATTERN
        bool "Custom blink pattern"
        default n
        help
          Enable custom blink pattern for the LED.

  endmenu

endif # LED_ADVANCED_SETTINGS

endif # LED_SUBSYSTEM

source "Kconfig.zephyr"
```

## prj.conf
```kconfig
CONFIG_GPIO=y
CONFIG_LOG=y

CONFIG_L6TASK1_DRIVER=y
CONFIG_SHELL=y
```

## app.overlay
```dts
/ {
	aliases {
		app-led = &green_led;
	};
	my_fake_sensor: l6task1_sensor {
		compatible = "l6task1,driver";
		status = "okay";
	};
};
```

## src/main.cpp
```c
#include <l6task1-driver/l6task2_driver.h>

#include <zephyr/drivers/sensor.h>
#include <zephyr/kernel.h>
#include <zephyr/logging/log.h>
#include <stdio.h>

LOG_MODULE_REGISTER(main, LOG_LEVEL_INF);

// get a handle to the fake sensor device
static const struct device *p_my_fake_sensor = DEVICE_DT_GET(DT_NODELABEL(my_fake_sensor));


int main(void)
{
    while (1)
    {
        // turn on LED
        sensor_sample_fetch(p_my_fake_sensor);
        l6task2_driver_custom_api_function_incr_sample_fetch_cnt(p_my_fake_sensor);
        k_msleep(CONFIG_APP_HEARTBEAT_PERIOD);
        // Turn off LED
        sensor_channel_get(p_my_fake_sensor, SENSOR_CHAN_ALL, NULL);
        l6task2_driver_custom_api_function_incr_channel_get_cnt(p_my_fake_sensor);
        k_msleep(CONFIG_APP_HEARTBEAT_PERIOD);
    }
    return 0;
}
```
