## boards/mod5_assgnmnt1/Kconfig
```kconfig
# Copyright 2025 NXP
# SPDX-License-Identifier: Apache-2.0

config BOARD_MOD5_ASSGNMNT1
	select BOARD_EARLY_INIT_HOOK
```

## boards/mod5_assgnmnt1/Kconfig.mod5_assgnmnt1
```kconfig
# Copyright 2024 NXP
# SPDX-License-Identifier: Apache-2.0

config BOARD_MOD5_ASSGNMNT1
	select SOC_PART_NUMBER_RW612ETA2I
```

## boards/mod5_assgnmnt1/board.yml
```yaml
board:
  name: mod5_assgnmnt1
  full_name: MODULE5 ASSIGNMENT1
  vendor: iomico zephyr course
  socs:
    - name: rw612
```

## boards/mod5_assgnmnt2/board.yml
```yaml
board:
  name: mod5_assgnmnt2
  full_name: MODULE5 ASSIGNMENT2 - From Scratch
  vendor: iomico zephyr course
  socs:
    - name: rw612
```

## modules/l6task1-driver-module/drivers/l6task1-driver/Kconfig
```kconfig
menuconfig L6TASK1_DRIVER
	bool "L6 Task1 Driver"
	default y
	depends on DT_HAS_L6TASK1_DRIVER_ENABLED   # only if HW is present in the DT
  select GPIO
	help
		Enable the L6 Task1 custom driver

if L6TASK1_DRIVER

config L6TASK1_DRIVER_INIT_PRIORITY
    int "L6TASK1 driver initialization priority"
    default 45
    help
      Initialization priority for the L6TASK1 driver.
      Must be greater than CONFIG_GPIO_INIT_PRIORITY to ensure
      GPIO is initialized first.

choice L6TASK1_DRIVER_LOG_LEVEL
    prompt "L6TASK1 driver log level"
    default L6TASK1_DRIVER_LOG_LEVEL_INF

config L6TASK1_DRIVER_LOG_LEVEL_NONE
    bool "No logging"
    help
      No logs.

config L6TASK1_DRIVER_LOG_LEVEL_ERR
    bool "Error"
    help
      Only errors.

config L6TASK1_DRIVER_LOG_LEVEL_WRN
    bool "Warning"
    
config L6TASK1_DRIVER_LOG_LEVEL_INF
    bool "Info"

config L6TASK1_DRIVER_LOG_LEVEL_DBG
    bool "Debug"

endchoice

config L6TASK1_DRIVER_LOG_LEVEL
    int
    default 0 if L6TASK1_DRIVER_LOG_LEVEL_NONE
    default 1 if L6TASK1_DRIVER_LOG_LEVEL_ERR
    default 2 if L6TASK1_DRIVER_LOG_LEVEL_WRN
    default 3 if L6TASK1_DRIVER_LOG_LEVEL_INF
    default 4 if L6TASK1_DRIVER_LOG_LEVEL_DBG

endif # L6TASK1_DRIVER
```
